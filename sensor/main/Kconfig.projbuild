## sensor/main/Kconfig.projbuild
```kconfig
menu "Weather Station Config"
    config ESP_WIFI_SSID
        string "WiFi SSID"
        help
            SSID (network name) for the example to connect to.

    config ESP_WIFI_PASSWORD
        string "WiFi Password"
        help
            WiFi password (WPA or WPA2) for the example to use.

    config ESP_MAXIMUM_RETRY
        int "Maximum retry"
        default 5
        help
            Set the Maximum retry to avoid station reconnecting to the AP unlimited when the AP is really inexistent.

    config MQTT_BROKER_HOST
        string "MQTT Host"
    config MQTT_BROKER_PORT
        int "MQTT Port"
        default 0
    config MQTT_BROKER_USER
        string "MQTT User"
    config MQTT_BROKER_PASSWD
        string "MQTT Password"

    config HTTP_LOG_HOST
        string "Host for posting logs"
    config HTTP_LOG_ENDPOINT
        string "Endpoint for the logs"
endmenu
```
